## config/west.yml
```yaml
manifest:
  remotes:
    # zmk official
    # - name: zmkfirmware
    #   url-base: https://github.com/zmkfirmware
    - name: infused-kim
      url-base: https://github.com/infused-kim
    - name: petejohanson
      url-base: https://github.com/petejohanson
      # bravekarma
   # - name: caksoylar
   #   url-base: https://github.com/caksoylar
      # kyek / duckyb
    - name: t0bybr
      url-base: https://github.com/t0bybr
  projects:
    # - name: zmk
    #   # remote: zmkfirmware
    #   # revision: main
    #   remote: petejohanson
    #   revision: feat/pointers-move-scroll
      # import: app/west.yml
    - name: urchin-zmk-module
      remote: t0bybr
      revision: main
    - name: kb_zmk_ps2_mouse_trackpoint_driver
      remote: infused-kim
      revision: main
    - name: zmk
      remote: infused-kim
      revision: pr-testing/mouse_ps2_module_base
      import: app/west.yml
  self:
    path: config
```
